## drivers/misc/lkm_sm/Kconfig
```kconfig
#
# MIT Sanctum security monitor interface
#

menu "MIT Sanctum security monitor interface"

config LKM_SM
	tristate "MIT Sanctum security monitor interface"
	default y

endmenu
```
